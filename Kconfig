## drivers/gpu/drm/bochs-v54/Kconfig
```kconfig
# SPDX-License-Identifier: GPL-2.0-only
config DRM_BOCHS
	tristate "DRM Support for bochs dispi vga interface (QEMU stdvga)"
	depends on DRM && PCI && MMU
	select DRM_KMS_HELPER
	select DRM_VRAM_HELPER
	help
	  Choose this option for QEMU's Bochs-compatible virtual VGA adapter.
	  The module binds PCI vendor/device 1234:1111 and creates a DRM KMS card.
```
